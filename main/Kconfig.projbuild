## main/Kconfig.projbuild
```kconfig
menu "Application Configuration"

	config TINYPICO_MAXIMUM_RETRY
		int "Maximum retry"
		default 5
		help
			Set the Maximum retry to avoid station reconnecting to the AP unlimited when the AP is really inexistent.

	config TINYPICO_STATIC_IP_ADDR
		string "Static IP address"
		default "192.168.0.1"
		help
			Set static IP address.

	config TINYPICO_STATIC_NETMASK_ADDR
		string "Static netmask address"
		default "255.255.255.0"
		help
			Set static netmask address.

	config TINYPICO_STATIC_GW_ADDR
		string "Static gateway address"
		default "192.168.0.1"
		help
			Set static gateway address.

	choice TINYPICO_STATIC_DNS_SERVER
		prompt "Choose DNS server"
		default TINYPICO_STATIC_DNS_AUTO
		help
			Select auto to make gateway address as DNS server or manual to input your DNS server
		config TINYPICO_STATIC_DNS_AUTO
			bool "Use gateway address as DNS server"
			help
				Set DNS server the same as gateway address

		config TINYPICO_STATIC_DNS_MANUAL
			bool "Set manual value as DNS server"
			help
				Set DNS server with you want
	endchoice

	config TINYPICO_STATIC_DNS_SERVER_MAIN
		string "Main DNS server address"
		default "192.168.0.1"
		depends on TINYPICO_STATIC_DNS_MANUAL
		help
			Set main DNS server address.

	config TINYPICO_STATIC_DNS_SERVER_BACKUP
		string "Backup DNS server address"
		default "192.168.0.1"
		depends on TINYPICO_STATIC_DNS_MANUAL
		help
			Set backup DNS server address. It can be same with the main DNS server address or leave empty.

	config TINYPICO_STATIC_DNS_RESOLVE_TEST
		bool "Enable DNS resolve test"
		default n
		help
			Enable it and configure TINYPICO_STATIC_RESOLVE_DOMAIN to resolve DNS domain name

	config TINYPICO_STATIC_RESOLVE_DOMAIN
		string "Domain name to resolve"
		default "www.espressif.com"
		depends on TINYPICO_STATIC_DNS_RESOLVE_TEST
		help
			Set domain name for DNS test

	choice WIFI_CONNECT
		bool "Select the Wifi connection method"
		default WIFI_CONNECT_APSTA
		help
			Select Wifi connection.
		config WIFI_CONNECT_AP
			bool "Connect to Wifi using AP mode."
		config WIFI_CONNECT_STA
			bool "Connect to Wifi using STA mode."
		config WIFI_CONNECT_APSTA
			bool "Connect to Wifi using APSTA mode"
	endchoice

	comment "for WiFi AP Setting"
		depends on WIFI_CONNECT_AP || WIFI_CONNECT_APSTA

	config AP_WIFI_SSID
		depends on WIFI_CONNECT_AP || WIFI_CONNECT_APSTA
		string "WiFi SSID of AP mode"
		default "ap-ssid"
		help
			SSID (network name) for the example to connect to.

	config AP_WIFI_PASSWORD
		depends on WIFI_CONNECT_AP || WIFI_CONNECT_APSTA
		string "WiFi Password of AP mode"
		default "ap-password"
		help
			WiFi password (WPA or WPA2) for the example to use.

	config AP_WIFI_CHANNEL
		depends on WIFI_CONNECT_AP || WIFI_CONNECT_APSTA
		int "WiFi Channel of AP mode"
		range 1 13
		default 1
		help
			WiFi channel (network channel) for the example to use.

	config AP_MAX_STA_CONN
		depends on WIFI_CONNECT_AP || WIFI_CONNECT_APSTA
		int "Maximal STA connections of AP mode"
		default 4
		help
			Max number of the STA connects to AP.

	comment "for WiFi STA Setting"
		depends on WIFI_CONNECT_STA || WIFI_CONNECT_APSTA

	config STA_WIFI_SSID
		depends on WIFI_CONNECT_STA || WIFI_CONNECT_APSTA
		string "WiFi SSID of STA mode"
		default "sta-ssid"
		help
			SSID (network name) for the example to connect to.

	config STA_WIFI_PASSWORD
		depends on WIFI_CONNECT_STA || WIFI_CONNECT_APSTA
		string "WiFi Password of STA mode"
		default "sta-password"
		help
			WiFi password (WPA or WPA2) for the example to use.

	config STA_CONNECT_TIMEOUT
		depends on WIFI_CONNECT_STA || WIFI_CONNECT_APSTA
		int "Connect timeout of STA mode"
		default 5
		help
			Set the connection timeout to avoid station reconnecting to the AP unlimited when the AP is really inexistent.
endmenu
```
